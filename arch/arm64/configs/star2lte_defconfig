## arch/arm64/configs/star2lte_defconfig
```kconfig
#
# Modifications for Samsung Galaxy S9+ (star2lte)
#
CONFIG_CAMERA_CIS_3M3_OBJ=y
CONFIG_CAMERA_STAR2=y
CONFIG_OIS_USE_RUMBA_S6=y
```

## arch/arm64/configs/starlte_defconfig
```kconfig
#
# Modifications for Samsung Galaxy S9 (starlte)
#
CONFIG_OIS_USE_RUMBA_S4=y
CONFIG_CAMERA_STAR=y
```
